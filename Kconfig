## Kconfig
```kconfig
menuconfig PAW3222
    bool "PAW3222 mouse optical sensor"
    select SPI
    help
      Enable PAW3222 mouse optical sensor.

if PAW3222

config PAW3222_POLL_INTERVAL_MS
    int "Motion polling interval while the sensor reports motion (ms)"
    default 15
    range 4 50
    help
      After a motion interrupt the driver polls the sensor at this interval
      until motion stops, then re-arms the interrupt. Lower values give a
      smoother cursor at the cost of more SPI traffic and current.

endif
```

## dts/bindings/pixart,paw3222.yaml
```yaml
# Copyright 2024 Google LLC
# Copyright 2025 sekigon-gonnoc
# SPDX-License-Identifier: Apache-2.0

description: PAW32xx ultra low power wireless mouse chip

compatible: "pixart,paw3222"

include: spi-device.yaml

properties:
  irq-gpios:
    type: phandle-array
    required: true
    description:
      GPIO connected to the motion pin, active low.

  power-gpios:
    type: phandle-array
    required: false
    description:
      GPIO connected to the power control pin.

  res-cpi:
    type: int
    description: |
      CPI resolution for the sensor. This can also be changed in runtime using
      the paw32xx_set_resolution() API.

  force-awake:
    type: boolean
    description: |
      Initialize the sensor in "force awake" mode. This can also be enabled or
      disabled in runtime by the application using the paw32xx_force_awake()
      API.

  invert-x:
    type: boolean
    description: |
      Invert the X axis reported by the sensor. Use when the sensor is mounted
      rotated relative to the keyboard.

  invert-y:
    type: boolean
    description: |
      Invert the Y axis reported by the sensor.

  swap-xy:
    type: boolean
    description: |
      Swap the X and Y axes reported by the sensor. Applied before invert-x /
      invert-y.

  no-invert-x:
    type: boolean
    description: |
      Disable the X axis inversion. In this fork the inversion is enabled by
      default because torabo-tsuki LP reports both axes reversed.

  no-invert-y:
    type: boolean
    description: |
      Disable the Y axis inversion. See no-invert-x.
```

## keyboard/firmware/boards/shields/tsumugi/Kconfig.shield
```kconfig
# Tsumugi base halves
config SHIELD_TSUMUGI_LEFT
    def_bool $(shields_list_contains,tsumugi_left)

config SHIELD_TSUMUGI_RIGHT
    def_bool $(shields_list_contains,tsumugi_right)

# Module-bay add-ons (combine with a base half, e.g. "tsumugi_right tsumugi_ball_right")
config SHIELD_TSUMUGI_BALL_RIGHT
    def_bool $(shields_list_contains,tsumugi_ball_right)

config SHIELD_TSUMUGI_BALL_LEFT
    def_bool $(shields_list_contains,tsumugi_ball_left)

config SHIELD_TSUMUGI_TRACKPAD_RIGHT
    def_bool $(shields_list_contains,tsumugi_trackpad_right)

config SHIELD_TSUMUGI_TRACKPAD_LEFT
    def_bool $(shields_list_contains,tsumugi_trackpad_left)

config SHIELD_TSUMUGI_LEFT_SCROLL_CENTRAL
    def_bool $(shields_list_contains,tsumugi_left_scroll_central)

config SHIELD_TSUMUGI_ENCODER
    def_bool $(shields_list_contains,tsumugi_encoder)
```
