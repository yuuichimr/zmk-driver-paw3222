/*
 * Add-on: 25 mm (or 19 mm) trackball in the RIGHT (central) bay -> main cursor.
 * Layer-dependent behaviour (scroll / precision / auto-mouse) lives in the keymap.
 */
&spi0 {
    status = "okay";
};

&trackball {
    status = "okay";
};

&cursor_listener {
    status = "okay";
    device = <&trackball>;
};
