/* Add-on: 23 mm Cirque trackpad in the RIGHT (central) bay -> main cursor (tap = click). */
&i2c0 {
    status = "okay";
};

&trackpad {
    status = "okay";
};

&cursor_listener {
    status = "okay";
    device = <&trackpad>;
};
