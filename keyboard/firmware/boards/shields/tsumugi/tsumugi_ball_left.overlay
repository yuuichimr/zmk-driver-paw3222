/*
 * Add-on: trackball in the LEFT (peripheral) bay. Motion is forwarded to the
 * central through the input-split device; the central applies the processors
 * (see tsumugi_left_scroll_central).
 */
&spi0 {
    status = "okay";
};

&trackball {
    status = "okay";
};

&left_pointer_split {
    status = "okay";
    device = <&trackball>;
};
